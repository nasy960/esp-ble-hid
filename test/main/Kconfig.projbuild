## test/main/Kconfig.projbuild
```kconfig
menu "USB BLE input switch"
    config INPUT_SWITCH_BUTTON
        int "Mouse HID button used to switch PCs (4=Back, 5=Forward)"
        range 4 5
        default 4
    config INPUT_SWITCH_LOG_INPUT
        bool "Print decoded USB input reports"
        default n
    config INPUT_SWITCH_LED_ENABLED
        bool "Use onboard WS2812 RGB status LED"
        default y
    config INPUT_SWITCH_LED_GPIO
        int "WS2812 GPIO (YD-ESP32-S3: 48)"
        depends on INPUT_SWITCH_LED_ENABLED
        range 0 48
        default 48
    config INPUT_SWITCH_LED_BRIGHTNESS
        int "RGB channel brightness (0=off, 255=maximum)"
        depends on INPUT_SWITCH_LED_ENABLED
        range 0 255
        default 2
endmenu
```

## test/sdkconfig.defaults
```kconfig
CONFIG_IDF_TARGET="esp32s3"
CONFIG_ESP_CONSOLE_UART_DEFAULT=y
CONFIG_ESP_CONSOLE_SECONDARY_NONE=y
CONFIG_USB_HOST_HUBS_SUPPORTED=y
CONFIG_BT_ENABLED=y
CONFIG_BT_NIMBLE_ENABLED=y
# Suppress per-report GATT notify chatter, retain NimBLE warnings/errors.
CONFIG_BT_NIMBLE_LOG_LEVEL_WARNING=y
# CONFIG_BT_BLUEDROID_ENABLED is not set
CONFIG_BT_NIMBLE_MAX_CONNECTIONS=2
CONFIG_BT_NIMBLE_MAX_BONDS=8
CONFIG_BT_NIMBLE_MAX_CCCDS=24
CONFIG_BT_NIMBLE_NVS_PERSIST=y
CONFIG_BT_NIMBLE_SM_SC=y
CONFIG_BT_NIMBLE_SM_LEGACY=y
CONFIG_BT_NIMBLE_ROLE_CENTRAL=y
# CONFIG_BT_NIMBLE_ROLE_OBSERVER is not set
CONFIG_BT_NIMBLE_ROLE_PERIPHERAL=y
CONFIG_BT_NIMBLE_ROLE_BROADCASTER=y
CONFIG_BT_CTRL_BLE_MAX_ACT=4
CONFIG_INPUT_SWITCH_BUTTON=4
CONFIG_INPUT_SWITCH_LED_ENABLED=y
CONFIG_INPUT_SWITCH_LED_GPIO=48
CONFIG_INPUT_SWITCH_LED_BRIGHTNESS=2
# CONFIG_INPUT_SWITCH_LOG_INPUT is not set
# Allow hub power and receiver firmware to settle on hot plug.
CONFIG_USB_HOST_EXT_PORT_CUSTOM_POWER_ON_DELAY_ENABLE=y
CONFIG_USB_HOST_EXT_PORT_CUSTOM_POWER_ON_DELAY_MS=500
CONFIG_USB_HOST_EXT_PORT_RESET_RECOVERY_DELAY_MS=100
CONFIG_USB_HOST_RESET_RECOVERY_MS=100

CONFIG_BT_NIMBLE_GATT_CLIENT=y
```
